## Kconfig
```kconfig
mainmenu "Memory Allocator Subsystem Permutator Configuration"


source "pre-existing/pre-existing.Kconfig"

if !MALLOC_PREEXISTING
source "memory-source/memory-source.Kconfig"

source "block-allocator/block-allocator.Kconfig"

source "extant/extant.Kconfig"
endif
```

## block-allocator/Kconfig
```kconfig
choice
        prompt "Block allocator"
        default MALLOC_BLOCK_ALLOCATOR_BUDDY
        help
          Select the block allocator.

          Block allocators are mutually exclusive. Exactly one
          allocator is selected.

config MALLOC_BLOCK_ALLOCATOR_BUDDY
        bool "Buddy block allocator"

config MALLOC_BLOCK_ALLOCATOR_TREES
        bool "Trees block allocator"

config MALLOC_BLOCK_ALLOCATOR_SEGREGATED_FREE_LIST
        bool "Segregated free list allocator"

config MALLOC_BLOCK_ALLOCATOR_BITMAP
        bool "Bitmap block allocator"

config MALLOC_BLOCK_ALLOCATOR_HYBRIDS
        bool "Hybrid block allocator"

endchoice

if MALLOC_BLOCK_ALLOCATOR_BUDDY
source "block-allocator/buddy/Kconfig"
endif
if MALLOC_BLOCK_ALLOCATOR_HYBRIDS
source "block-allocator/hybrids/Kconfig"
endif
if MALLOC_BLOCK_ALLOCATOR_TREES
source "block-allocator/trees/Kconfig"
endif
if MALLOC_BLOCK_ALLOCATOR_SEGREGATED_FREE_LIST
source "block-allocator/segregated-free-list/Kconfig"
endif
if MALLOC_BLOCK_ALLOCATOR_BITMAP
source "block-allocator/bitmap/Kconfig"
endif
```

## block-allocator/buddy/Kconfig
```kconfig
if MALLOC_BLOCK_ALLOCATOR_BUDDY

comment "Buddy allocators"

choice
        prompt "Buddy algorithm"
        default MALLOC_BUDDY_BINARY
        help
          Select the buddy allocation algorithm.

          Buddy algorithms are mutually exclusive. Exactly one
          algorithm is selected.

config MALLOC_BUDDY_BINARY
        bool "Binary buddy"

config MALLOC_BUDDY_FIBONACCI
        bool "Fibonacci buddy"

config MALLOC_BUDDY_WEIGHTED
        bool "Weighted buddy"

config MALLOC_BUDDY_DOUBLE
        bool "Double buddy"

endchoice

#if MALLOC_BUDDY_BINARY
source "block-allocator/buddy/binary/Kconfig"
#endif
#if MALLOC_BUDDY_FIBONACCI
source "block-allocator/buddy/fibonacci/Kconfig"
#endif
#if MALLOC_BUDDY_WEIGHTED
source "block-allocator/buddy/weighted/Kconfig"
#endif
#if MALLOC_BUDDY_DOUBLE
source "block-allocator/buddy/double/Kconfig"
#endif


endif
```

## buddy/Kconfig
```kconfig
menuconfig MALLOC_BUDDY
	bool "Buddy allocator"
	help
	  Enable the buddy memory allocator.

if MALLOC_BUDDY

choice
	prompt "Buddy algorithm"
	default MALLOC_BUDDY_BINARY
	help
	  Select the buddy allocation algorithm.

	  Buddy algorithms are mutually exclusive. Exactly one
	  algorithm is selected.

config MALLOC_BUDDY_BINARY
	bool "Binary buddy"
	select MALLOC_BUDDY_POWER_OF_TWO

config MALLOC_BUDDY_FIBONACCI
	bool "Fibonacci buddy"

config MALLOC_BUDDY_WEIGHTED
	bool "Weighted buddy"

config MALLOC_BUDDY_DOUBLE
	bool "Double buddy"

endchoice

source "buddy/binary/Kconfig"
source "buddy/fibonacci/Kconfig"
source "buddy/weighted/Kconfig"
source "buddy/double/Kconfig"

endif
```

## buddy/fibonacci/Kconfig
```kconfig
if MALLOC_BUDDY_FIBONACCI


choice
    prompt "Buddy lookup implementation"
    default MALLOC_BUDDY_FIBONACCI_LAYOUT

config MALLOC_BUDDY_FIBONACCI_SEARCH
    bool "Free-list search"
    help
      Locate Fibonacci buddies by searching the appropriate
      free list.

      This implementation is intended for the Wave 1
      allocator prototype.

config MALLOC_BUDDY_FIBONACCI_LAYOUT
    bool "Use explicit fibonacci memory layout metadata"
    help
      Maintain explicit Fibonacci split metadata.

      Buddy identification does not search the free lists.
      This implementation is intended for production use.

endchoice

config MALLOC_BUDDY_FIBONACCI_BASE
    int "Minimum allocation size"
    default 16
    range 1 65536

config MALLOC_BUDDY_FIBONACCI_CLASSES
    int "Number of allocation classes"
    default 32
    range 2 128

endif
```

## buddy/weighted/Kconfig
```kconfig
if MALLOC_BUDDY_WEIGHTED

config MALLOC_BUDDY_WEIGHTED_MIN_ORDER
	int "Minimum allocation order"
	default 0
	range 0 63

config MALLOC_BUDDY_WEIGHTED_MAX_ORDER
	int "Maximum allocation order"
	default 20
	range 2 63

choice
	prompt "Free-list policy"
	default MALLOC_BUDDY_WEIGHTED_FIFO

config MALLOC_BUDDY_WEIGHTED_FIFO
	bool "FIFO"

config MALLOC_BUDDY_WEIGHTED_LIFO
	bool "LIFO"

config MALLOC_BUDDY_WEIGHTED_LARGEST_BUDDY
	bool "Largest buddy"

endchoice

choice
	prompt "Split policy"
	default MALLOC_BUDDY_WEIGHTED_SMALLEST

config MALLOC_BUDDY_WEIGHTED_SMALLEST
	bool "Smallest sufficient buddy"

config MALLOC_BUDDY_WEIGHTED_LARGEST
	bool "Largest buddy"

endchoice

endif
```
